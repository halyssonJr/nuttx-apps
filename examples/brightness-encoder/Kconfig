## examples/brightness-encoder/Kconfig
```kconfig
#
# For a description of the syntax of this configuration file,
# see the file kconfig-language.txt in the NuttX tools repository.
#

config EXAMPLES_BRIGHTNESS_ENCONDER
	tristate "Brightness Enconder example"
	default n
	---help---
		Enable the Brightness Enconder example

if EXAMPLES_BRIGHTNESS_ENCONDER

config EXAMPLES_BRIGHTNESS_ENCONDER_PROGNAME
	string "Program name"
	default "BrightnessEnconder"
	---help---
		This is the name of the program that will be used when the NSH ELF
		program is installed.

config EXAMPLES_BRIGHTNESS_ENCONDER_PRIORITY
	int "Brightness Enconder task priority"
	default 100

config EXAMPLES_BRIGHTNESS_ENCONDER_STACKSIZE
	int "Brightness Enconder stack size"
	default DEFAULT_TASK_STACKSIZE

endif
```

## examples/mbedtls_client/Kconfig
```kconfig
#
# For a description of the syntax of this configuration file,
# see the file kconfig-language.txt in the NuttX tools repository.
#

config EXAMPLES_MBEDTLS_CLIENT
	tristate "mbedtls client example"
	default n
	---help---
		Enable the mbedtls example

if EXAMPLES_MBEDTLS_CLIENT

config EXAMPLES_MBEDTLS_CLIENT_PROGNAME
	string "Program name"
	default "mbedtls"
	---help---
		This is the name of the program that will be used when the NSH ELF
		program is installed.

config EXAMPLES_MBEDTLS_CLIENT_PRIORITY
	int "mbedtls task priority"
	default 100

config EXAMPLES_MBEDTLS_CLIENT_STACKSIZE
	int "mbedtls stack size"
	default DEFAULT_TASK_STACKSIZE

endif
```
